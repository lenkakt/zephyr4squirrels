## CMakeLists.txt
```
# Copyright (c) 2026 Lenka Koskova Triskova <lenka@koskova.cz>
#
# SPDX-License-Identifier: Apache-2.0

cmake_minimum_required(VERSION 3.20.0)

find_package(Zephyr REQUIRED HINTS $ENV{ZEPHYR_BASE})
project(devicetree)

target_sources(app PRIVATE src/main.c)
```

## prj.conf
```kconfig
# Copyright (c) 2026 Lenka Koskova Triskova <lenka@koskova.cz>
#
# SPDX-License-Identifier: Apache-2.0

CONFIG_PRINTK=y

# QEMU emulates ESP32 chip revision 0, which Zephyr's boot code flags as
# unsupported by default (it just refuses to continue otherwise). This has
# no effect on real M5Stack Fire hardware, which reports a supported
# revision, so it's safe to leave on for both QEMU and real hardware.
CONFIG_ESP32_USE_UNSUPPORTED_REVISION=y

CONFIG_GPIO=y
```

## src/main.c
```c
#include <zephyr/kernel.h>
#include <zephyr/drivers/gpio.h>

#define SW0_NODE DT_ALIAS(sw0)

static const struct gpio_dt_spec sw0 = GPIO_DT_SPEC_GET(SW0_NODE, gpios);

int main(void)
{
	/* Raw devicetree values: resolved entirely at compile time by the
	 * preprocessor, no driver involved yet. */
	printk("sw0 label: %s\n", DT_PROP(SW0_NODE, label));
	printk("sw0 pin:   %d\n", DT_GPIO_PIN(SW0_NODE, gpios));

	/* Now bind the GPIO driver to that same node and actually read it. */
	if (!gpio_is_ready_dt(&sw0)) {
		printk("sw0 device not ready\n");
		return 0;
	}

	gpio_pin_configure_dt(&sw0, GPIO_INPUT);
	printk("sw0 level: %d\n", gpio_pin_get_dt(&sw0));

	return 0;
}
```
