## CMakeLists.txt
```
# Copyright (c) 2026 Lenka Koskova Triskova <lenka@koskova.cz>
#
# SPDX-License-Identifier: Apache-2.0

cmake_minimum_required(VERSION 3.20.0)

find_package(Zephyr REQUIRED HINTS $ENV{ZEPHYR_BASE})
project(sync)

target_sources(app PRIVATE src/main.c)
```

## prj.conf
```kconfig
# Copyright (c) 2026 Lenka Koskova Triskova <lenka@koskova.cz>
#
# SPDX-License-Identifier: Apache-2.0

CONFIG_PRINTK=y

# QEMU emulates ESP32 chip revision 0, which Zephyr's boot code flags as
# unsupported by default (it just refuses to continue otherwise). This has
# no effect on real M5Stack Fire hardware, which reports a supported
# revision, so it's safe to leave on for both QEMU and real hardware.
CONFIG_ESP32_USE_UNSUPPORTED_REVISION=y
```

## src/main.c
```c
/*
 * Copyright (c) 2026 Lenka Koskova Triskova <lenka@koskova.cz>
 *
 * SPDX-License-Identifier: Apache-2.0
 */

/*
 * sync
 *
 * Two threads increment the same shared counter, unprotected. The
 * increment is deliberately split into a read, a k_yield() (to force a
 * preemption right in the middle -- widening a race that's real either
 * way, just usually rarer and less convenient to reproduce on demand),
 * and a write. Expect this to print a wrong total; see docs/07-synchronization.md.
 */

#include <zephyr/kernel.h>

#define STACKSIZE     1024
#define PRIORITY      5
#define N_INCREMENTS  5

static int shared_counter;

static void increment_unsafe(void)
{
	int temp = shared_counter;

	k_yield();
	shared_counter = temp + 1;
}

static void racer(void *unused1, void *unused2, void *unused3)
{
	ARG_UNUSED(unused1);
	ARG_UNUSED(unused2);
	ARG_UNUSED(unused3);

	for (int i = 0; i < N_INCREMENTS; i++) {
		increment_unsafe();
	}
}

K_THREAD_DEFINE(racer1_id, STACKSIZE, racer, NULL, NULL, NULL, PRIORITY, 0, 0);
K_THREAD_DEFINE(racer2_id, STACKSIZE, racer, NULL, NULL, NULL, PRIORITY, 0, 0);

int main(void)
{
	/* Give both racer threads time to finish before we read the result. */
	k_msleep(500);
	printk("shared_counter = %d (expected %d)\n", shared_counter, 2 * N_INCREMENTS);

	return 0;
}
```
